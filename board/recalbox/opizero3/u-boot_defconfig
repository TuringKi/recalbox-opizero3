## configs/recalbox-opizero3_defconfig
```kconfig
BR2_aarch64=y
BR2_cortex_a53=y
BR2_ARM_FPU_VFPV4=y
BR2_GLOBAL_PATCH_DIR="$(BR2_EXTERNAL_RECALBOX_PATH)/board/recalbox/patches $(BR2_EXTERNAL_RECALBOX_PATH)/board/recalbox/patches/arm"

BR2_PACKAGE_HOST_LINUX_HEADERS_CUSTOM_6_1=y
BR2_ROOTFS_DEVICE_CREATION_DYNAMIC_MDEV=y
BR2_SYSTEM_DHCP="eth0"

# Firmware
BR2_TARGET_ARM_TRUSTED_FIRMWARE=y
BR2_TARGET_ARM_TRUSTED_FIRMWARE_CUSTOM_VERSION=y
BR2_TARGET_ARM_TRUSTED_FIRMWARE_CUSTOM_VERSION_VALUE="v2.9"
BR2_TARGET_ARM_TRUSTED_FIRMWARE_PLATFORM="sun50i_h616"
BR2_TARGET_ARM_TRUSTED_FIRMWARE_BL31=y

# Bootloader
BR2_TARGET_UBOOT=y
BR2_TARGET_UBOOT_BUILD_SYSTEM_KCONFIG=y
BR2_TARGET_UBOOT_CUSTOM_TARBALL=y
BR2_TARGET_UBOOT_CUSTOM_TARBALL_LOCATION="$(call github,orangepi-xunlong,u-boot-orangepi,6fe17fac388aad17490cf386578b7532975e567f)/u-boot-orangepi-6fe17fac388aad17490cf386578b7532975e567f.tar.gz"
BR2_TARGET_UBOOT_BOARD_DEFCONFIG="orangepi_zero3"
BR2_TARGET_UBOOT_NEEDS_DTC=y
BR2_TARGET_UBOOT_NEEDS_OPENSSL=y
BR2_TARGET_UBOOT_NEEDS_PYTHON3=y
BR2_TARGET_UBOOT_NEEDS_PYLIBFDT=y
BR2_TARGET_UBOOT_NEEDS_ATF_BL31=y
BR2_TARGET_UBOOT_SPL=y
BR2_TARGET_UBOOT_SPL_NAME="u-boot-sunxi-with-spl.bin"
BR2_TARGET_UBOOT_CONFIG_FRAGMENT_FILES="$(BR2_EXTERNAL_RECALBOX_PATH)/board/recalbox/opizero3/u-boot_defconfig"
BR2_TARGET_UBOOT_CUSTOM_MAKEOPTS="SCP=/dev/null"

# Kernel
BR2_LINUX_KERNEL=y
BR2_LINUX_KERNEL_CUSTOM_TARBALL=y
BR2_LINUX_KERNEL_CUSTOM_TARBALL_LOCATION="$(call github,orangepi-xunlong,linux-orangepi,3495b5ee0594566c9fed930b96b1cae90600412e)/linux-orangepi-3495b5ee0594566c9fed930b96b1cae90600412e.tar.gz"
BR2_LINUX_KERNEL_DEFCONFIG="linux_sunxi64"
BR2_LINUX_KERNEL_DTS_SUPPORT=y
BR2_LINUX_KERNEL_INTREE_DTS_NAME="allwinner/sun50i-h616-orangepi-zero3"
BR2_LINUX_KERNEL_NEEDS_HOST_OPENSSL=y
BR2_LINUX_KERNEL_INSTALL_TARGET=y
BR2_LINUX_KERNEL_DTB_KEEP_DIRNAME=y
BR2_LINUX_KERNEL_CONFIG_FRAGMENT_FILES="board/orangepi/orangepi-zero3/linux.config"
BR2_LINUX_KERNEL_GZIP=y


# host tools
BR2_PACKAGE_HOST_GENIMAGE=y
BR2_PACKAGE_HOST_UBOOT_TOOLS=y



BR2_OPTIMIZE_3=y
BR2_SHARED_STATIC_LIBS=y
BR2_TOOLCHAIN_BUILDROOT_GLIBC=y
BR2_GCC_ENABLE_OPENMP=y
BR2_GCC_ENABLE_LTO=y
BR2_TOOLCHAIN_BUILDROOT_CXX=y
BR2_GCC_ENABLE_GRAPHITE=y
BR2_TARGET_OPTIMIZATION="-pipe -fsigned-char"
BR2_TARGET_GENERIC_HOSTNAME="RECALBOX"
BR2_TARGET_GENERIC_ISSUE="PLAY AGAIN"
BR2_INIT_SYSV=y
BR2_ROOTFS_DEVICE_CREATION_DYNAMIC_EUDEV=y
BR2_TARGET_GENERIC_ROOT_PASSWD="233"
BR2_SYSTEM_BIN_SH_BASH=y
BR2_TARGET_GENERIC_GETTY_PORT="tty1"
BR2_TARGET_GENERIC_GETTY_BAUDRATE_115200=y
# BR2_TARGET_GENERIC_REMOUNT_ROOTFS_RW is not set
BR2_ENABLE_LOCALE_WHITELIST="C ar ca cs de el en en_US es eu_ES fr gl_ES hu it ja_JP ko lb_LU lt_LT lv_LV nb nn_NO nl no pl pt pt_BR ro ru_RU sk_SK sv_SE tr uk_UA zh_CN zh_TW"
BR2_GENERATE_LOCALE="en_US.UTF-8 ar_YE.UTF-8 ca_ES.UTF-8 cs_CZ.UTF-8 de_DE.UTF-8 de_CH.UTF-8 el_GR.UTF-8 es_ES.UTF-8 eu_ES.UTF-8 fr_FR.UTF-8 hu_HU.UTF-8 it_IT.UTF-8 ja_JP.UTF-8 ko_KR.UTF-8 lb_LU.UTF-8 lv_LV.UTF-8 nb_NO.UTF-8 nn_NO.UTF-8 nl_NL.UTF-8 pl_PL.UTF-8 pt_BR.UTF-8 ru_RU.UTF-8 sk_SK.UTF-8 sv_SE.UTF-8 tr_TR.UTF-8 uk_UA.UTF-8 zh_CN.UTF-8 zh_TW.UTF-8"
BR2_TARGET_TZ_INFO=y
BR2_TARGET_LOCALTIME="Europe/Paris"
BR2_ROOTFS_OVERLAY="$(BR2_EXTERNAL_RECALBOX_PATH)/board/recalbox/fsoverlay"

; BR2_ROOTFS_POST_BUILD_SCRIPT="$(BR2_EXTERNAL_RECALBOX_PATH)/board/recalbox/opizero3/post-build.sh"
; BR2_ROOTFS_POST_IMAGE_SCRIPT="support/scripts/genimage.sh"
; BR2_ROOTFS_POST_SCRIPT_ARGS="-c $(BINARIES_DIR)/genimage.cfg"

BR2_ROOTFS_POST_BUILD_SCRIPT="$(BR2_EXTERNAL_RECALBOX_PATH)/board/recalbox/recalbox-patch-target.sh"
BR2_ROOTFS_POST_IMAGE_SCRIPT="$(BR2_EXTERNAL_RECALBOX_PATH)/board/recalbox/copy-recalbox-archives.sh"


BR2_PACKAGE_BUSYBOX_CONFIG_FRAGMENT_FILES="$(BR2_EXTERNAL_RECALBOX_PATH)/board/recalbox/busybox.custom.config"


BR2_TARGET_GENERIC_ISSUE="Welcome to Orangepi Zero3"
BR2_TARGET_ROOTFS_SQUASHFS=y
BR2_TARGET_ROOTFS_SQUASHFS4_LZO=y


BR2_PACKAGE_ALSA_UTILS=y
BR2_PACKAGE_ALSA_UTILS_AMIXER=y
BR2_PACKAGE_FFMPEG_GPL=y
BR2_PACKAGE_FFMPEG_FFPLAY=y
BR2_PACKAGE_FFMPEG_FFPROBE=y
BR2_PACKAGE_MPV=y
BR2_PACKAGE_P7ZIP=y
BR2_PACKAGE_UNZIP=y
BR2_PACKAGE_ZIP=y
BR2_PACKAGE_BINUTILS=y
BR2_PACKAGE_DIFFUTILS=y
BR2_PACKAGE_CIFS_UTILS=y
BR2_PACKAGE_DOSFSTOOLS=y
BR2_PACKAGE_DOSFSTOOLS_FSCK_FAT=y
BR2_PACKAGE_DOSFSTOOLS_MKFS_FAT=y
BR2_PACKAGE_EXFAT=y
BR2_PACKAGE_EXFAT_UTILS=y
BR2_PACKAGE_NTFS_3G=y
BR2_PACKAGE_NTFS_3G_NTFSPROGS=y
BR2_PACKAGE_FBDUMP=y
BR2_PACKAGE_FBGRAB=y
BR2_PACKAGE_FBV=y
BR2_PACKAGE_SDL_IMAGE_XPM=y
BR2_PACKAGE_SDL_MIXER=y
BR2_PACKAGE_SDL_NET=y
BR2_PACKAGE_SDL2_KMSDRM=y
BR2_PACKAGE_SDL2_OPENGLES=y
BR2_PACKAGE_XKEYBOARD_CONFIG=y
BR2_PACKAGE_DBUS_CPP=y
BR2_PACKAGE_DBUS_TRIGGERD=y
BR2_PACKAGE_EUDEV_RULES_GEN=y
BR2_PACKAGE_EVTEST=y
BR2_PACKAGE_I2C_TOOLS=y
BR2_PACKAGE_KBD=y
BR2_PACKAGE_LINUXCONSOLETOOLS=y
BR2_PACKAGE_LIRC_TOOLS=y
BR2_PACKAGE_PARTED=y
BR2_PACKAGE_USBMOUNT=y
BR2_PACKAGE_USBUTILS=y
BR2_PACKAGE_NODEJS_MODULES_ADDITIONAL="request"
BR2_PACKAGE_PYTHON3_PY_PYC=y
BR2_PACKAGE_PYTHON_LIBUSB1=y
BR2_PACKAGE_PYTHON_PAHO_MQTT=y
BR2_PACKAGE_PYTHON_PSUTIL=y
BR2_PACKAGE_TCL=y
BR2_PACKAGE_EXPECT=y
BR2_PACKAGE_SNAPPY=y
BR2_PACKAGE_LIBWEBSOCKETS=y
BR2_PACKAGE_CA_CERTIFICATES=y
BR2_PACKAGE_LIBOPENSSL_BIN=y
BR2_PACKAGE_LIBUSB_COMPAT=y
BR2_PACKAGE_LIBBLURAY=y
BR2_PACKAGE_X264=y
BR2_PACKAGE_X265=y
BR2_PACKAGE_LIBCURL_CURL=y
BR2_PACKAGE_NCURSES_WCHAR=y
BR2_PACKAGE_PCRE2=y
BR2_PACKAGE_PCRE2_16=y
BR2_PACKAGE_BLUEZ5_UTILS_CLIENT=y
BR2_PACKAGE_BLUEZ5_UTILS_DEPRECATED=y
BR2_PACKAGE_BLUEZ5_UTILS_PLUGINS_SIXAXIS=y
BR2_PACKAGE_BLUEZ5_UTILS_TEST=y
BR2_PACKAGE_BLUEZ5_UTILS_TOOLS_HID2HCI=y
BR2_PACKAGE_CRDA=y
BR2_PACKAGE_DHCPCD=y
BR2_PACKAGE_DROPBEAR=y
BR2_PACKAGE_GESFTPSERVER=y
BR2_PACKAGE_IW=y
BR2_PACKAGE_MOSQUITTO=y
BR2_PACKAGE_NTP=y
BR2_PACKAGE_RSYNC=y
BR2_PACKAGE_WGET=y
BR2_PACKAGE_WPA_SUPPLICANT_DBUS_INTROSPECTION=y
BR2_PACKAGE_WPA_SUPPLICANT_WPA3=y
BR2_PACKAGE_WPA_SUPPLICANT_WPS=y
BR2_PACKAGE_HTOP=y
BR2_PACKAGE_PROCPS_NG=y
BR2_PACKAGE_TAR=y
BR2_PACKAGE_UTIL_LINUX_LOSETUP=y
BR2_PACKAGE_UTIL_LINUX_RFKILL=y
BR2_PACKAGE_UTIL_LINUX_SETTERM=y
BR2_PACKAGE_NANO=y
BR2_PACKAGE_VIM=y
BR2_PACKAGE_EVWAIT=y
BR2_PACKAGE_RECALBOX_CONFIGGEN=y
BR2_PACKAGE_RECALBOX_INITRAMFS=y
BR2_PACKAGE_RECALBOX_ROMFS2=y
BR2_PACKAGE_RECALBOX_SYSTEM=y
BR2_PACKAGE_RECALBOX_TARGET_OPIZERO3=y
BR2_PACKAGE_RECALBOX_THEMES=y
BR2_PACKAGE_RECALBOX_HARDWARE=y
BR2_PACKAGE_PYTHON_RPI_GPIO=y
BR2_PACKAGE_RECALBOX_SETTINGS=y
BR2_PACKAGE_RECALBOX_VIDEOMODE=y
BR2_PACKAGE_UBOOT_ODROIDGO2=y
BR2_PACKAGE_RECALBOX_EMULATIONSTATION2=y
BR2_PACKAGE_HATARI=y
BR2_PACKAGE_ADVANCEMAME=y
BR2_PACKAGE_DUCKSTATION=y
BR2_PACKAGE_BEEBEM=y
BR2_PACKAGE_FROTZ_RECALBOX=y
BR2_PACKAGE_MUPEN64PLUS_AUDIO_SDL=y
BR2_PACKAGE_MUPEN64PLUS_CORE=y
BR2_PACKAGE_MUPEN64PLUS_INPUT_SDL=y
BR2_PACKAGE_MUPEN64PLUS_RSPHLE=y
BR2_PACKAGE_MUPEN64PLUS_UICONSOLE=y
BR2_PACKAGE_MUPEN64PLUS_VIDEO_RICE=y
BR2_PACKAGE_MUPEN64PLUS_VIDEO_GLIDE64MK2=y
BR2_PACKAGE_ORICUTRON=y
BR2_PACKAGE_PPSSPP=y
BR2_PACKAGE_SIMCOUPE=y
BR2_PACKAGE_AMIBERRY33=y
BR2_PACKAGE_DOSBOX=y
BR2_PACKAGE_GSPLUS=y
BR2_PACKAGE_HYPSEUS=y
BR2_PACKAGE_OPENBOR=y
BR2_PACKAGE_RB5000=y
BR2_PACKAGE_RETROARCH=y
BR2_PACKAGE_SCUMMVM=y
BR2_PACKAGE_SOLARUS_RECALBOX=y
BR2_PACKAGE_TI99SIM=y
BR2_PACKAGE_XROAR=y
BR2_PACKAGE_VICE=y
BR2_PACKAGE_LIBRETRO_81=y
BR2_PACKAGE_LIBRETRO_2048=y
BR2_PACKAGE_LIBRETRO_A5200=y
BR2_PACKAGE_LIBRETRO_ATARI800=y
BR2_PACKAGE_LIBRETRO_ARDUOUS=y
BR2_PACKAGE_LIBRETRO_BK_EMULATOR=y
BR2_PACKAGE_LIBRETRO_FREEINTV=y
BR2_PACKAGE_LIBRETRO_BEETLE_LYNX=y
BR2_PACKAGE_LIBRETRO_BEETLE_NGP=y
BR2_PACKAGE_LIBRETRO_BEETLE_PCE_FAST=y
BR2_PACKAGE_LIBRETRO_BEETLE_SUPERGRAFX=y
BR2_PACKAGE_LIBRETRO_BEETLE_VB=y
BR2_PACKAGE_LIBRETRO_BEETLE_WSWAN=y
BR2_PACKAGE_LIBRETRO_BLUEMSX=y
BR2_PACKAGE_LIBRETRO_CANNONBALL=y
BR2_PACKAGE_LIBRETRO_CAP32=y
BR2_PACKAGE_LIBRETRO_CROCODS=y
BR2_PACKAGE_LIBRETRO_DINOTHAWR=y
BR2_PACKAGE_LIBRETRO_DOSBOX_PURE=y
BR2_PACKAGE_LIBRETRO_EASYRPG=y
BR2_PACKAGE_LIBRETRO_ECWOLF=y
BR2_PACKAGE_LIBRETRO_EMUSCV=y
BR2_PACKAGE_LIBRETRO_FBNEO=y
BR2_PACKAGE_LIBRETRO_FCEUMM=y
BR2_PACKAGE_LIBRETRO_FCEUNEXT=y
BR2_PACKAGE_LIBRETRO_FLYCAST=y
BR2_PACKAGE_LIBRETRO_FMSX=y
BR2_PACKAGE_LIBRETRO_FREECHAF=y
BR2_PACKAGE_LIBRETRO_FUSE=y
BR2_PACKAGE_LIBRETRO_GAMBATTE=y
BR2_PACKAGE_LIBRETRO_GEARCOLECO=y
BR2_PACKAGE_LIBRETRO_GEARSYSTEM=y
BR2_PACKAGE_LIBRETRO_GENESISPLUSGX=y
BR2_PACKAGE_LIBRETRO_GENESISPLUSGXWIDE=y
BR2_PACKAGE_LIBRETRO_GONG=y
BR2_PACKAGE_LIBRETRO_GPSP=y
BR2_PACKAGE_LIBRETRO_GW=y
BR2_PACKAGE_LIBRETRO_HANDY=y
BR2_PACKAGE_LIBRETRO_HATARI=y
BR2_PACKAGE_LIBRETRO_IMAGEVIEWER=y
BR2_PACKAGE_LIBRETRO_LOWRES_NX=y
BR2_PACKAGE_LIBRETRO_LUTRO=y
BR2_PACKAGE_LIBRETRO_MAME2003_PLUS=y
BR2_PACKAGE_LIBRETRO_MAME2003=y
BR2_PACKAGE_LIBRETRO_MAME2010=y
# BR2_PACKAGE_LIBRETRO_MAME2015=y
BR2_PACKAGE_LIBRETRO_MESEN=y
BR2_PACKAGE_LIBRETRO_MESEN_S=y
BR2_PACKAGE_LIBRETRO_METEOR=y
BR2_PACKAGE_LIBRETRO_MGBA=y
BR2_PACKAGE_LIBRETRO_MINIVMAC=y
BR2_PACKAGE_LIBRETRO_MOJOZORK=y
BR2_PACKAGE_LIBRETRO_MRBOOM=y
BR2_PACKAGE_LIBRETRO_MU=y
BR2_PACKAGE_LIBRETRO_MUPEN64PLUS_NX=y
BR2_PACKAGE_LIBRETRO_NESTOPIA=y
BR2_PACKAGE_LIBRETRO_NEOCD=y
BR2_PACKAGE_LIBRETRO_NP2KAI=y
BR2_PACKAGE_LIBRETRO_NXENGINE=y
BR2_PACKAGE_LIBRETRO_O2EM=y
BR2_PACKAGE_LIBRETRO_OPERA=y
BR2_PACKAGE_LIBRETRO_PARALLEL_N64=y
BR2_PACKAGE_LIBRETRO_PCSX_REARMED=y
BR2_PACKAGE_LIBRETRO_PICODRIVE=y
BR2_PACKAGE_LIBRETRO_POKEMINI=y
BR2_PACKAGE_LIBRETRO_POTATOR=y
BR2_PACKAGE_LIBRETRO_PRBOOM=y
BR2_PACKAGE_LIBRETRO_PROSYSTEM=y
BR2_PACKAGE_LIBRETRO_PPSSPP=y
BR2_PACKAGE_LIBRETRO_PX68K=y
BR2_PACKAGE_LIBRETRO_QUASI88=y
BR2_PACKAGE_LIBRETRO_QUICKNES=y
BR2_PACKAGE_LIBRETRO_RACE=y
BR2_PACKAGE_LIBRETRO_REMINISCENCE=y
BR2_PACKAGE_LIBRETRO_RETRO8=y
BR2_PACKAGE_LIBRETRO_SAMEBOY=y
BR2_PACKAGE_LIBRETRO_SAMEDUCK=y
BR2_PACKAGE_LIBRETRO_SNES9X=y
BR2_PACKAGE_LIBRETRO_SNES9X2002=y
BR2_PACKAGE_LIBRETRO_SNES9X2005=y
BR2_PACKAGE_LIBRETRO_SNES9X2010=y
BR2_PACKAGE_LIBRETRO_STELLA=y
BR2_PACKAGE_LIBRETRO_SWANSTATION=y
BR2_PACKAGE_LIBRETRO_TGBDUAL=y
BR2_PACKAGE_LIBRETRO_THEODORE=y
BR2_PACKAGE_LIBRETRO_TIC80=y
BR2_PACKAGE_LIBRETRO_TYRQUAKE=y
BR2_PACKAGE_LIBRETRO_UAE=y
BR2_PACKAGE_LIBRETRO_UAE4ARM=y
BR2_PACKAGE_LIBRETRO_UZEM=y
BR2_PACKAGE_LIBRETRO_VECX=y
BR2_PACKAGE_LIBRETRO_VICE=y
BR2_PACKAGE_LIBRETRO_VITAQUAKE2=y
BR2_PACKAGE_LIBRETRO_XMIL=y
BR2_PACKAGE_LIBRETRO_XRICK=y
BR2_PACKAGE_LIBRETRO_YABASANSHIRO=y
BR2_PACKAGE_LIBRETRO_WASM4=y
BR2_PACKAGE_FBV_RECALBOX=y
BR2_PACKAGE_JSTEST2=y
BR2_PACKAGE_WSD=y
BR2_PACKAGE_LIBRETRO_CHEATS=y
BR2_PACKAGE_MEGATOOLS=y
BR2_PACKAGE_FLUIDSYNTH_PULSEAUDIO=y
BR2_PACKAGE_PAMIX=y
BR2_PACKAGE_KMSGRAB=y
```
